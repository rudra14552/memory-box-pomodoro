#include <SPI.h>
#include <Wire.h>
#include <Adafruit_GFX.h>
#include <Adafruit_SSD1306.h>

// -------- PINS --------
#define SCREEN_WIDTH 128
#define SCREEN_HEIGHT 64
#define OLED_RESET     -1
#define SCREEN_ADDRESS 0x3C

#define BTN_D2  2   // Timer: adjust minutes / hold to start
#define BTN_D3  3   // Enter / Exit timer mode
#define BUZZER  13
#define LED_PIN 12

Adafruit_SSD1306 display(SCREEN_WIDTH, SCREEN_HEIGHT, &Wire, OLED_RESET);

// ======================================================
// BITMAPS
// ======================================================
extern const unsigned char bitmap1[] PROGMEM = {
  0x00, 0x00, 0x00, 0x00, 0x00, 0x00, 0x00, 0x00, 0x00, 0x00, 0x00, 0x00, 0x00, 0x00, 0x00, 0x00, 
	0x00, 0x00, 0x00, 0x00, 0x00, 0x00, 0x00, 0x00, 0x00, 0x00, 0x00, 0x00, 0x00, 0x00, 0x00, 0x00, 
	0x00, 0x00, 0x00, 0x00, 0x00, 0x00, 0x00, 0x00, 0x00, 0x00, 0x00, 0x00, 0x00, 0x00, 0x00, 0x00, 
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	0x00, 0x00, 0x00, 0x00, 0x00, 0x00, 0x00, 0x00, 0x00, 0x00, 0x00, 0x00, 0x00, 0x00, 0x00, 0x00
};
extern const unsigned char bitmap2[] PROGMEM = {
  0x00, 0x00, 0x00, 0x00, 0x00, 0x00, 0x00, 0x00, 0x00, 0x00, 0x00, 0x00, 0x00, 0x00, 0x00, 0x00, 
	0x00, 0x00, 0x00, 0x00, 0x00, 0x00, 0x00, 0x00, 0x00, 0x00, 0x00, 0x00, 0x00, 0x00, 0x00, 0x00, 
	0x00, 0x00, 0x00, 0x00, 0x00, 0x00, 0x00, 0x00, 0x00, 0x00, 0x00, 0x00, 0x00, 0x00, 0x00, 0x00, 
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	0x00, 0x00, 0x00, 0x00, 0x00, 0x00, 0x00, 0x00, 0x00, 0x00, 0x00, 0x00, 0x00, 0x00, 0x00, 0x00
};
extern const unsigned char bitmap3[] PROGMEM = {
  0x00, 0x00, 0x00, 0x00, 0x00, 0x00, 0x00, 0x00, 0x00, 0x00, 0x00, 0x00, 0x00, 0x00, 0x00, 0x00, 
	0x00, 0x00, 0x00, 0x00, 0x00, 0x00, 0x00, 0x00, 0x00, 0x00, 0x00, 0x00, 0x00, 0x00, 0x00, 0x00, 
	0x00, 0x00, 0x00, 0x00, 0x00, 0x00, 0x00, 0x00, 0x00, 0x00, 0x00, 0x00, 0x00, 0x00, 0x00, 0x00, 
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	0x00, 0x00, 0x00, 0x00, 0x00, 0x00, 0x00, 0x00, 0x00, 0x00, 0x00, 0x00, 0x00, 0x00, 0x00, 0x00
};
extern const unsigned char bitmap4[] PROGMEM = {
  0x00, 0x00, 0x00, 0x00, 0x00, 0x00, 0x00, 0x00, 0x00, 0x00, 0x00, 0x00, 0x00, 0x00, 0x00, 0x00, 
	0x00, 0x00, 0x00, 0x00, 0x00, 0x00, 0x00, 0x00, 0x00, 0x00, 0x00, 0x00, 0x00, 0x00, 0x00, 0x00, 
	0x00, 0x00, 0x00, 0x00, 0x00, 0x00, 0x00, 0x00, 0x00, 0x00, 0x00, 0x00, 0x00, 0x00, 0x00, 0x00, 
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	0x00, 0x00, 0x00, 0x00, 0x00, 0x00, 0x00, 0x00, 0x00, 0x00, 0x00, 0x00, 0x00, 0x00, 0x00, 0x00
};
extern const unsigned char bitmap5[] PROGMEM = {
  0x00, 0x00, 0x00, 0x00, 0x00, 0x00, 0x00, 0x00, 0x00, 0x00, 0x00, 0x00, 0x00, 0x00, 0x00, 0x00, 
	0x00, 0x00, 0x00, 0x00, 0x00, 0x00, 0x00, 0x00, 0x00, 0x00, 0x00, 0x00, 0x00, 0x00, 0x00, 0x00, 
	0x00, 0x00, 0x00, 0x00, 0x00, 0x00, 0x00, 0x00, 0x00, 0x00, 0x00, 0x00, 0x00, 0x00, 0x00, 0x00, 
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	0x00, 0x00, 0x00, 0x00, 0x00, 0x00, 0x00, 0x00, 0x00, 0x00, 0x00, 0x00, 0x00, 0x00, 0x00, 0x00
};
extern const unsigned char bitmap6[] PROGMEM = {
  0x00, 0x00, 0x00, 0x00, 0x00, 0x00, 0x00, 0x00, 0x00, 0x00, 0x00, 0x00, 0x00, 0x00, 0x00, 0x00, 
	0x00, 0x00, 0x00, 0x00, 0x00, 0x00, 0x00, 0x00, 0x31, 0x80, 0x00, 0x00, 0x00, 0x00, 0x00, 0x00, 
	0x00, 0x00, 0x00, 0x00, 0x00, 0x00, 0x00, 0x00, 0x7f, 0xc0, 0x00, 0x00, 0x00, 0x00, 0x00, 0x00, 
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	0x00, 0x00, 0x00, 0x00, 0x00, 0x00, 0x00, 0x00, 0x00, 0x00, 0x00, 0x00, 0x00, 0x00, 0x00, 0x00
};

// ======================================================
// BITMAP + DATE ARRAYS
// ======================================================
const unsigned char* bitmaps[] = {
  bitmap1, bitmap2, bitmap3, bitmap4, bitmap5, bitmap6
};
String dates[] = {
  "13/09/25", "20/09/25", "06/02/26",
  "15/02/26", "08/03/26", "18/03/26"
};
uint16_t dateColor[] = {
  WHITE, WHITE, WHITE, WHITE, WHITE, WHITE
};
const int TOTAL_BITMAPS = 6;

// ======================================================
// STATE MACHINE
// ======================================================
enum AppMode { MODE_BITMAP, MODE_TIMER, MODE_ALARM };
AppMode appMode = MODE_BITMAP;

// ======================================================
// BITMAP SLIDESHOW STATE
// ======================================================
int   currentScreen      = 0;
unsigned long lastScreenChange = 0;
const unsigned long SCREEN_INTERVAL = 59UL * 60UL * 1000UL; // 59 minutes

// ======================================================
// LED STROBE STATE (bitmap mode only)
// ======================================================
// Pattern: ON(40) -> OFF(80) -> ON(40) -> PAUSE(2500)
int   strobeState        = 0;
unsigned long lastStrobeTime = 0;
const unsigned long strobeTiming[] = {40, 80, 40, 2500};

// ======================================================
// TIMER STATE
// ======================================================
int   timerMinutes       = 5;
unsigned long timerTotalSeconds = 0;
bool  timerRunning       = false;
unsigned long lastTick   = 0;

// D2 button state
bool  d2LastState        = HIGH;
unsigned long d2PressStart = 0;
bool  d2Held             = false;

// ======================================================
// D3 BUTTON STATE
// ======================================================
bool  d3LastState        = HIGH;

// ======================================================
// ALARM STATE
// ======================================================
unsigned long alarmStart = 0;
const unsigned long ALARM_DURATION  = 10000; // 10 seconds
int   alarmState         = 0;
unsigned long lastAlarmToggle = 0;
const unsigned long ALARM_TOGGLE_MS = 120;

// ======================================================
// HELPERS
// ======================================================
void drawBitmapScreen(int index) {
  display.clearDisplay();
  display.drawBitmap(0, 0, bitmaps[index], 128, 64, WHITE);

  display.setTextSize(1);
  display.setTextColor(dateColor[index]);
  String date = dates[index];
  int16_t textWidth = date.length() * 6;
  int16_t x = 128 - textWidth - 2;
  int16_t y = 56;
  display.fillRect(x, y, textWidth + 2, 8, BLACK);
  display.setCursor(x, y);
  display.print(date);
  display.display();
}

// -------------------------------------------------------
// FIX: use fixed pixel positions instead of getTextBounds
// Adafruit GFX default font, size 1 = 6px/char wide, 8px tall
// size 3 = 18px/char wide, 24px tall
// "TIMER" (5 chars) @ size1 = 30px  → x = (128-30)/2 = 49
// "00:00" (5 chars) @ size3 = 90px  → x = (128-90)/2 = 19
// "D2:+5m|Hold:Start" (19 chars) @ size1 = 114px → x = 7
// -------------------------------------------------------
void drawTimerScreen() {
  display.clearDisplay();

  int mn, sc;
  if (timerRunning) {
    mn = timerTotalSeconds / 60;
    sc = timerTotalSeconds % 60;
  } else {
    mn = timerMinutes;
    sc = 0;
  }

  char timeStr[6];
  sprintf(timeStr, "%02d:%02d", mn, sc);

  // "TIMER" label — centered at top
  display.setTextSize(1);
  display.setTextColor(WHITE);
  display.setCursor(49, 5);
  display.print(F("TIMER"));

  // Large countdown — centered
  display.setTextSize(3);
  display.setTextColor(WHITE);
  display.setCursor(19, 24);
  display.print(timeStr);

  // Bottom hint — only when not yet running
  if (!timerRunning) {
    display.setTextSize(1);
    display.setTextColor(WHITE);
    display.setCursor(7, 56);
    display.print(F("D2:+5m | Hold:Start"));
  }

  display.display();
}

void enterTimerMode() {
  appMode           = MODE_TIMER;
  timerMinutes      = 5;
  timerRunning      = false;
  timerTotalSeconds = 0;
  d2LastState       = HIGH;
  d2Held            = false;
  drawTimerScreen();
}

void exitToBitmap() {
  timerRunning = false;
  noTone(BUZZER);
  digitalWrite(LED_PIN, LOW);

  appMode          = MODE_BITMAP;
  strobeState      = 0;
  lastStrobeTime   = millis();
  digitalWrite(LED_PIN, HIGH);  // kick off first flash

  drawBitmapScreen(currentScreen);
}

void startAlarm() {
  appMode         = MODE_ALARM;
  alarmStart      = millis();
  alarmState      = 0;
  lastAlarmToggle = millis();
  digitalWrite(LED_PIN, HIGH);
  tone(BUZZER, 2000);
}

// ======================================================
// STROBE (bitmap mode only)
// ======================================================
void updateStrobe() {
  unsigned long now = millis();
  if (now - lastStrobeTime >= strobeTiming[strobeState]) {
    lastStrobeTime = now;

    if (strobeState == 0 || strobeState == 2) {
      digitalWrite(LED_PIN, LOW);
    } else if (strobeState == 1) {
      digitalWrite(LED_PIN, HIGH);
    }

    strobeState = (strobeState + 1) % 4;

    if (strobeState == 0) {
      digitalWrite(LED_PIN, HIGH);
    }
  }
}

// ======================================================
// ALARM UPDATE (non-blocking, 10 sec)
// ======================================================
void updateAlarm() {
  unsigned long now = millis();

  if (now - lastAlarmToggle >= ALARM_TOGGLE_MS) {
    lastAlarmToggle = now;
    alarmState = !alarmState;
    if (alarmState) {
      digitalWrite(LED_PIN, HIGH);
      tone(BUZZER, 2000);
    } else {
      digitalWrite(LED_PIN, LOW);
      noTone(BUZZER);
    }
  }

  if (now - alarmStart >= ALARM_DURATION) {
    noTone(BUZZER);
    digitalWrite(LED_PIN, LOW);
    exitToBitmap();
  }
}

// ======================================================
// TIMER TICK
// ======================================================
void updateTimer() {
  if (!timerRunning) return;

  unsigned long now = millis();
  if (now - lastTick >= 1000) {
    lastTick += 1000;
    if (timerTotalSeconds > 0) {
      timerTotalSeconds--;
      drawTimerScreen();
    } else {
      timerRunning = false;
      startAlarm();
    }
  }
}

// ======================================================
// D2 BUTTON (timer mode: adjust + hold-to-start)
// ======================================================
void handleD2() {
  bool state = digitalRead(BTN_D2);

  if (state == LOW && d2LastState == HIGH) {
    d2PressStart = millis();
    d2Held       = false;
  }

  // Hold >800ms → start timer
  if (state == LOW && !d2Held && (millis() - d2PressStart > 800)) {
    if (!timerRunning) {
      timerTotalSeconds = (unsigned long)timerMinutes * 60;
      timerRunning      = true;
      lastTick          = millis();
      drawTimerScreen();
    }
    d2Held = true;
  }

  // Short press release → add 5 minutes (only when not running)
  if (state == HIGH && d2LastState == LOW) {
    if (!d2Held && !timerRunning) {
      timerMinutes += 5;
      if (timerMinutes > 60) timerMinutes = 5;
      drawTimerScreen();
    }
  }

  d2LastState = state;
}

// ======================================================
// D3 BUTTON (enter / cancel timer mode)
// ======================================================
void handleD3() {
  bool state = digitalRead(BTN_D3);

  // Detect rising edge (release)
  if (state == HIGH && d3LastState == LOW) {
    if (appMode == MODE_BITMAP) {
      enterTimerMode();
    } else if (appMode == MODE_TIMER) {
      exitToBitmap();  // cancel — running or not
    }
    // MODE_ALARM: D3 ignored, alarm auto-stops after 10 s
  }

  d3LastState = state;
}

// ======================================================
// SETUP
// ======================================================
void setup() {
  Serial.begin(9600);

  pinMode(BTN_D2, INPUT_PULLUP);
  pinMode(BTN_D3, INPUT_PULLUP);
  pinMode(BUZZER,  OUTPUT);
  pinMode(LED_PIN, OUTPUT);

  digitalWrite(BUZZER,  LOW);
  digitalWrite(LED_PIN, LOW);

  if (!display.begin(SSD1306_SWITCHCAPVCC, SCREEN_ADDRESS)) {
    Serial.println(F("SSD1306 allocation failed"));
    for (;;);
  }

  strobeState      = 0;
  lastStrobeTime   = millis();
  lastScreenChange = millis();
  digitalWrite(LED_PIN, HIGH);

  drawBitmapScreen(0);
}

// ======================================================
// LOOP
// ======================================================
void loop() {
  handleD3();  // always check D3 first

  if (appMode == MODE_BITMAP) {
    if (millis() - lastScreenChange >= SCREEN_INTERVAL) {
      lastScreenChange = millis();
      currentScreen    = (currentScreen + 1) % TOTAL_BITMAPS;
      drawBitmapScreen(currentScreen);
    }
    updateStrobe();

  } else if (appMode == MODE_TIMER) {
    handleD2();
    updateTimer();

  } else if (appMode == MODE_ALARM) {
    updateAlarm();
  }
}
